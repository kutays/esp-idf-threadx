## components/freertos/Kconfig
```kconfig
# SPDX-License-Identifier: Apache-2.0
# Kconfig stubs for CONFIG_FREERTOS_* options checked by ESP-IDF components.
# When ThreadX is selected, these provide default values so ESP-IDF code compiles.
# When FreeRTOS is selected, the real Kconfig from $IDF_PATH takes over
# (but our override component is active, so we must provide these).

menu "FreeRTOS"

    config FREERTOS_HZ
        int "Tick rate (Hz)"
        default 100

    config FREERTOS_UNICORE
        bool
        default y
        select ESP_SYSTEM_SINGLE_CORE_MODE

    config FREERTOS_NUMBER_OF_CORES
        int
        default 1

    config FREERTOS_THREAD_LOCAL_STORAGE_POINTERS
        int "Thread local storage pointers"
        default 2

    config FREERTOS_IDLE_TASK_STACKSIZE
        int "Idle task stack size"
        default 1536

    config FREERTOS_MAX_TASK_NAME_LEN
        int "Max task name length"
        default 16

    config FREERTOS_TIMER_TASK_STACK_DEPTH
        int "Timer task stack depth"
        default 2048

    config FREERTOS_TIMER_QUEUE_LENGTH
        int "Timer queue length"
        default 10

    config FREERTOS_TIMER_TASK_PRIORITY
        int "Timer task priority"
        default 1

    config FREERTOS_CHECK_STACKOVERFLOW
        int "Stack overflow check method"
        default 2

    config FREERTOS_DEBUG_OCDAWARE
        bool "OpenOCD debug awareness"
        default y

    config FREERTOS_ENABLE_TASK_SNAPSHOT
        bool
        default n

    config FREERTOS_PLACE_FUNCTIONS_INTO_FLASH
        bool
        default n

    config FREERTOS_ISR_STACKSIZE
        int "ISR stack size"
        default 1536

    config FREERTOS_NO_AFFINITY
        # Not used by ThreadX at runtime (ESP32-C6 is single-core).
        # Required as a build-system dependency: ESP-IDF Kconfig files
        # (esp_system, esp_timer, lwip) reference this symbol as a default
        # for hex options like ESP_MAIN_TASK_AFFINITY. Without it, kconfgen
        # tries to parse the string "FREERTOS_NO_AFFINITY" as a hex literal
        # and crashes. Value 0x7FFFFFFF = INT_MAX = "no core affinity".
        hex
        default 0x7FFFFFFF

    config FREERTOS_TASK_FUNCTION_WRAPPER
        bool
        default n

    config FREERTOS_TLSP_DELETION_CALLBACKS
        bool
        default y

    config FREERTOS_ENABLE_BACKWARD_COMPATIBILITY
        bool
        default y

    config FREERTOS_USE_TRACE_FACILITY
        bool "configUSE_TRACE_FACILITY"
        default n

    config FREERTOS_USE_LIST_DATA_INTEGRITY_CHECK_BYTES
        # In ThreadX mode, txfr_sem_t (~96 bytes) exceeds the default
        # struct __lock size (84 bytes). Enabling this bumps struct __lock
        # to int reserved[27] = 108 bytes, satisfying the static assertion
        # in newlib/locks.c. In FreeRTOS mode, this enables the actual
        # FreeRTOS list data integrity check feature (default off).
        bool "configUSE_LIST_DATA_INTEGRITY_CHECK_BYTES"
        default y if RTOS_SELECTION_THREADX
        default n

endmenu
```

## components/threadx/Kconfig
```kconfig
# SPDX-License-Identifier: Apache-2.0
menu "RTOS Selection"
    depends on IDF_TARGET_ESP32C6

    choice RTOS_SELECTION
        prompt "Select RTOS"
        default RTOS_SELECTION_THREADX
        help
            Select which RTOS to use. ThreadX is only available on ESP32-C6.
            FreeRTOS is the safe default — all ESP-IDF components work normally.
            When ThreadX is selected, it hooks into ESP-IDF startup via
            port_start_app_hook() and the FreeRTOS scheduler never starts.

        config RTOS_SELECTION_FREERTOS
            bool "FreeRTOS (ESP-IDF default)"
            help
                Standard ESP-IDF FreeRTOS. All ESP-IDF WiFi, BT, and driver
                components work normally.

        config RTOS_SELECTION_THREADX
            bool "ThreadX (Azure RTOS, ESP32-C6 only)"
            help
                Azure RTOS ThreadX. The FreeRTOS compatibility layer
                (tx_freertos.c) is available for components that use FreeRTOS APIs.
                Note: WiFi/BT stack compatibility is not fully validated.
    endchoice

endmenu

menu "ThreadX Configuration"
    depends on RTOS_SELECTION_THREADX

    config THREADX_TICK_RATE_HZ
        int "Tick rate (Hz)"
        default 100
        range 10 1000
        help
            Number of ThreadX timer ticks per second. Sets TX_TIMER_TICKS_PER_SECOND.
            The SYSTIMER alarm period is 1,000,000 / tick_rate microseconds.
            100 Hz = 10ms tick (recommended). 1000 Hz = 1ms tick (high CPU overhead).

    config THREADX_MAX_PRIORITIES
        int "Maximum thread priority levels"
        default 32
        range 8 256
        help
            Sets TX_MAX_PRIORITIES. Lower number = higher priority in ThreadX.
            Increasing this uses more RAM (one pointer per priority level).

    config THREADX_BYTE_POOL_SIZE
        int "System byte pool size (bytes)"
        default 32768
        range 4096 131072
        help
            Size of the system byte pool used for dynamic allocations
            via tx_byte_allocate(). Used by the FreeRTOS compatibility layer
            for xTaskCreate, xQueueCreate, etc.

endmenu
```

## examples/freertos_demo/sdkconfig.defaults
```kconfig
# ESP32-C6 target
CONFIG_IDF_TARGET="esp32c6"

# CPU frequency
CONFIG_ESP_DEFAULT_CPU_FREQ_MHZ_160=y

# Disable watchdogs for initial debugging
CONFIG_ESP_TASK_WDT_EN=n
CONFIG_ESP_INT_WDT=n

# UART console
CONFIG_ESP_CONSOLE_UART_DEFAULT=y
CONFIG_ESP_CONSOLE_UART_BAUDRATE=115200

# Logging
CONFIG_LOG_DEFAULT_LEVEL_INFO=y

# FreeRTOS tick rate
CONFIG_FREERTOS_HZ=100

# Select FreeRTOS as the RTOS for this demo (default).
# Switch to CONFIG_RTOS_SELECTION_THREADX=y (via menuconfig or editing this
# file) to run the same code through the FreeRTOS compatibility layer on
# top of ThreadX — no changes to main.c required.
CONFIG_RTOS_SELECTION_FREERTOS=y
```

## examples/threadx_demo/sdkconfig.defaults
```kconfig
# ESP32-C6 target
CONFIG_IDF_TARGET="esp32c6"

# CPU frequency
CONFIG_ESP_DEFAULT_CPU_FREQ_MHZ_160=y

# Disable watchdogs for initial debugging
CONFIG_ESP_TASK_WDT_EN=n
CONFIG_ESP_INT_WDT=n

# UART console
CONFIG_ESP_CONSOLE_UART_DEFAULT=y
CONFIG_ESP_CONSOLE_UART_BAUDRATE=115200

# Logging
CONFIG_LOG_DEFAULT_LEVEL_INFO=y

# FreeRTOS tick rate (used by ESP-IDF internals even in ThreadX mode)
CONFIG_FREERTOS_HZ=100

# Select ThreadX as the RTOS for this demo
CONFIG_RTOS_SELECTION_THREADX=y
```

## examples/wifi_demo/sdkconfig.defaults
```kconfig
CONFIG_IDF_TARGET="esp32c6"

# RTOS selection
CONFIG_RTOS_SELECTION_THREADX=y

# ThreadX configuration
CONFIG_THREADX_TICK_RATE_HZ=100
CONFIG_THREADX_MAX_PRIORITIES=32
CONFIG_THREADX_BYTE_POOL_SIZE=65536

# WiFi
CONFIG_ESP_WIFI_ENABLED=y

# System
CONFIG_ESP_DEFAULT_CPU_FREQ_MHZ_160=y
CONFIG_ESP_TASK_WDT_EN=n
CONFIG_ESP_INT_WDT=n

# Console
CONFIG_ESP_CONSOLE_UART_DEFAULT=y
CONFIG_ESP_CONSOLE_UART_BAUDRATE=115200

# Logging
CONFIG_LOG_DEFAULT_LEVEL_INFO=y

# FreeRTOS stubs
CONFIG_FREERTOS_HZ=100
```

## sdkconfig.defaults
```kconfig
# ESP32-C6 target
CONFIG_IDF_TARGET="esp32c6"

# CPU frequency
CONFIG_ESP_DEFAULT_CPU_FREQ_MHZ_160=y

# Disable watchdogs for initial debugging
CONFIG_ESP_TASK_WDT_EN=n
CONFIG_ESP_INT_WDT=n

# UART console
CONFIG_ESP_CONSOLE_UART_DEFAULT=y
CONFIG_ESP_CONSOLE_UART_BAUDRATE=115200

# Logging
CONFIG_LOG_DEFAULT_LEVEL_INFO=y

# Disable FreeRTOS idle task watchdog
CONFIG_FREERTOS_HZ=100
```
